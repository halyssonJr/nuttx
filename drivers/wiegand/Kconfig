## drivers/wiegand/Kconfig
```kconfig
#
# For a description of the syntax of this configuration file,
# see the file kconfig-language.txt in the NuttX tools repository.
#

menuconfig DRIVERS_WIEGAND
	bool "Wiegand  Support"
	default n
	---help---
	Drivers for Wiegand Protocol.
```
